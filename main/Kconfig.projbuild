## main/Kconfig.projbuild
```kconfig
menu "TTS Server"

    config TTS_WIFI_SSID
        string "WiFi SSID"
        default "myssid"
        help
            Default WiFi SSID. Override at runtime via NVS key wifi_ssid in namespace tts_cfg.

    config TTS_WIFI_PASS
        string "WiFi Password"
        default ""
        help
            Default WiFi password. Override at runtime via NVS key wifi_pass in namespace tts_cfg.

    config TTS_HTTP_PORT
        int "HTTP server port"
        default 80
        range 1 65535
        help
            Port for the TTS HTTP server.

endmenu
```

## sdkconfig.defaults
```kconfig
CONFIG_ESPTOOLPY_FLASHSIZE_4MB=y
CONFIG_PARTITION_TABLE_CUSTOM=y
CONFIG_PARTITION_TABLE_CUSTOM_FILENAME="partitions.csv"
CONFIG_SPIRAM=y
CONFIG_SPIRAM_MODE_OCT=y
CONFIG_SPIRAM_USE_MALLOC=y
CONFIG_ESP32S3_DEFAULT_CPU_FREQ_240=y
CONFIG_HTTPD_MAX_REQ_HDR_LEN=1024
CONFIG_TTS_WIFI_SSID="workbench"
CONFIG_TTS_WIFI_PASS="testpass1"
CONFIG_PICOTTS_LANGUAGE_EN_GB=y
CONFIG_PICOTTS_RESOURCE_MODE_EMBED=y

# Disable WPA3/SAE - router is WPA2; IDF v5 SAE causes auth failures
CONFIG_ESP_WIFI_ENABLE_WPA3_SAE=n
```
